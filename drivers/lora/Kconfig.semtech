## drivers/lora/Kconfig.semtech
```kconfig
#
# Copyright (c) 2019 Manivannan Sadhasivam
#
# SPDX-License-Identifier: Apache-2.0
#

menuconfig LORA_SX12XX
	bool "Semtech SX-series driver"
	select HAS_SEMTECH_RADIO_DRIVERS
	select HAS_SEMTECH_LORAMAC
	depends on SPI
	depends on COUNTER
	help
	  Enable LoRa driver for Semtech SX12xx.

if LORA_SX12XX

choice
	prompt "LoRa Radio chipset"
	default LORA_SX1276

config LORA_SX1276
	bool "Semtech SX1276 driver"
	select HAS_SEMTECH_SX1276
	help
	  Enable LoRa driver for Semtech SX1276.

config LORA_SX126X
	bool "Semtech SX126x driver"
	select HAS_SEMTECH_SX126X
	help
	  Enable LoRa driver for Semtech SX126x.

endchoice

choice
	prompt "SX1276 PA Output pin"
	default PA_BOOST_PIN
	depends on LORA_SX1276
	help
	  Antenna connection type.

config PA_RFO_PIN
	bool "PA_RFO_PIN"
	help
	  Antenna connected to PA_RFO pin.

config PA_BOOST_PIN
	bool "PA_BOOST_PIN"
	help
	  Antenna connected to PA_BOOST pin.

endchoice

endif
```

## subsys/lorawan/Kconfig
```kconfig
# LoRaWAN configuration options

# Copyright (c) 2019 Manivannan Sadhasivam <mani@kernel.org>
# SPDX-License-Identifier: Apache-2.0

menuconfig LORAWAN
	bool "LoRaWAN support [EXPERIMENTAL]"
	depends on LORA
	select HAS_SEMTECH_LORAMAC
	select HAS_SEMTECH_SOFT_SE
	help
	  This option enables LoRaWAN support.

if LORAWAN

module = LORAWAN
module-str = lorawan
source "subsys/logging/Kconfig.template.log_config"

choice
	prompt "LoRaWAN Region Selection"
	default LORAMAC_REGION_IN865
	help
	  Select the LoRaWAN region.

config LORAMAC_REGION_AS923
	bool "Asia 923MHz Frequency band"

config LORAMAC_REGION_AU915
	bool "Australia 915MHz Frequency band"

config LORAMAC_REGION_CN470
	bool "China 470MHz Frequency band"

config LORAMAC_REGION_CN779
	bool "China 779MHz Frequency band"

config LORAMAC_REGION_EU433
	bool "Europe 433MHz Frequency band"

config LORAMAC_REGION_EU868
	bool "Europe 868MHz Frequency band"

config LORAMAC_REGION_KR920
	bool "South Korea 920MHz Frequency band"

config LORAMAC_REGION_IN865
	bool "India 865MHz Frequency band"

config LORAMAC_REGION_US915
	bool "North America 915MHz Frequency band"

config LORAMAC_REGION_RU864
	bool "Russia 864MHz Frequency band"

endchoice

choice
	prompt "LoRaWAN key management implentation"
	default LORAMAC_SE_SEMTECH
	help
	  Select the implementation of key storage / secure element.

config LORAMAC_SE_SEMTECH
	bool "Semtech soft SE"
	help
	  Use Semtech's reference implementation of a software key management.

config LORAMAC_SE_ZEPHYR
	bool "Zephyr soft SE [EXPERIMENTAL]"
	depends on CRYPTO
	select TINYCRYPT
	select TINYCRYPT_AES
	select TINYCRYPT_AES_CMAC
	select ENTROPY_GENERATOR
	help
	  Implement the SE in Zephyr

endchoice

if LORAMAC_SE_ZEPHYR

config LORAMAC_SE_CRYPTO_DEV_NAME
	string "Crypto device name used for secure element"
	default ""

config LORAMAC_SE_DEV_EUI_RO
	bool "Treat device EUI as read only"
	default n

config LORAMAC_SE_JOIN_EUI_RO
	bool "Treat join EUI as read only"
	default n

endif # LORAMAC_SE_ZEPHYR

endif # LORAWAN
```
